## components/network/Kconfig.projbuild
```kconfig
menu "NETWORK Configuration"

    choice NETWORK_IP_MODE
        prompt "IP Version"
        depends on NETWORK_SOCKET_IP_INPUT_STRING
        help
            NETWORK can use either IPV4 or IPV6.

        config NETWORK_IPV4
            bool "IPV4"

        config NETWORK_IPV6
            bool "IPV6"

    endchoice

    config NETWORK_IPV4_ADDR
        string "IPV4 Address"
        default "192.168.0.165"
        depends on NETWORK_IPV4
        help
            The NETWORK will connect to this IPV4 address.

    config NETWORK_IPV6_ADDR
        string "IPV6 Address"
        default "FE80::30AD:E57B:C212:68AD"
        depends on NETWORK_IPV6
        help
            The NETWORK will connect to this IPV6 address.

    config NETWORK_PORT
        int "Port"
        range 0 65535
        default 3333
        help
            The remote port to which the client NETWORK will connect to.

    choice NETWORK_INTERFACE
        prompt "Interface selection"
        depends on NETWORK_IPV6
        help
            NETWORK can use either "Auto" or "User specified".

        config NETWORK_IFACE_AUTO
            bool "Auto"

        config NETWORK_USER_SPECIFIED_IFACE
            bool "User specified interface"
    endchoice

    config NETWORK_USER_SPECIFIED_IFACE_NAME
        string "User specified interface name"
        default "st1"
        depends on NETWORK_USER_SPECIFIED_IFACE
        help
            This interface will be used for communication.

    choice NETWORK_SOCKET_IP_INPUT
        prompt "Socket NETWORK source"
        default NETWORK_SOCKET_IP_INPUT_STRING
        help
            Selects the input source of the IP used in the NETWORK.

        config NETWORK_SOCKET_IP_INPUT_STRING
            bool "From string"

        config NETWORK_SOCKET_IP_INPUT_STDIN
            bool "From stdin"
    endchoice

endmenu
```
